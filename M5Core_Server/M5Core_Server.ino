#include <BLEDevice.h>
#include <BLEUtils.h>
#include <BLEServer.h>
#include <M5Core2.h>
#include "/Users/laurencebank/Documents/Arduino/libraries/RemoteDisplay/rd_constants.h"

//static BLEUUID serviceUUID("fea0"); //Service
static BLEUUID serviceUUID("0000fea0-1234-1000-8000-00805f9b34fb"); //Service
static BLEUUID dataUUID1("0000fea1-1234-1000-8000-00805f9b34fb"); // data charact
//static BLEUUID dataUUID2("0000fea1-0000-1000-8000-00805f9b34fb"); // data charact
BLEServer *pServer;
BLEService *pService;
BLECharacteristic *pCharacteristic;
BLEAdvertising *pAdvertising;
TouchButton b0(0,200,106,40);
TouchButton b1(106,200,106,40);
TouchButton b2(212,200,106,40);
//TouchZone topHalf(0,0,320,120);
//TouchZone bottomHalf(0,120,320,160);
//Gesture swipeDown(topHalf, bottomHalf, "Swipe Down");
static bool bRefresh = false;
static int original_width, width, original_height, height, bpp, orientation;
static int display_type;
static int  cursor_x, window_w, window_x;
static int  cursor_y, window_h, window_y;
static uint16_t u16Buttons = 0;

// Horizontal resolution of each display type
const uint16_t xres_list[] = {
0, // invalid
240, //        RD_LCD_ILI9341, // 240x320
176, //        RD_LCD_ILI9225, // 176x220
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320, //        RD_LCD_ILI9486, // 320x480
        // Monochrome LCDs/OLEDs
128, //        RD_OLED_128x128,
128, //        RD_OLED_128x32,
128, //        RD_OLED_128x64,
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320, //        RD_EPOP_500
480  //        RD_EPOP_900
};
// Vertical resolution of each display type
const uint16_t yres_list[] = {
0, // invalid
320, //        RD_LCD_ILI9341, // 240x320
220, //        RD_LCD_ILI9225, // 176x220
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480, //        RD_LCD_ILI9486, // 320x480
        // Monochrome LCDs/OLEDs
128, //        RD_OLED_128x128,
32, //        RD_OLED_128x32,
64, //        RD_OLED_128x64,
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240, //        RD_EPOP_500
360  //        RD_EPOP_900
};
// Bits per pixel of each display type
const uint16_t bpp_list[] = {
0, // invalid
16, //        RD_LCD_ILI9341, // 240x320
16, //        RD_LCD_ILI9225, // 176x220
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16, //        RD_LCD_ILI9486, // 320x480
        // Monochrome LCDs/OLEDs
1, //        RD_OLED_128x128,
1, //        RD_OLED_128x32,
1, //        RD_OLED_128x64,
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1, //        RD_EPOP_500
1  //        RD_EPOP_900
};
// Built-in font data
const uint8_t ucFont[] = {
0x00,0x00,0x00,0x00,0x00,0x00,0x00,0x00,0x00,0x00,0x06,0x5f,0x5f,0x06,0x00,0x00,
0x00,0x07,0x07,0x00,0x07,0x07,0x00,0x00,0x14,0x7f,0x7f,0x14,0x7f,0x7f,0x14,0x00,
  0x24,0x2e,0x2a,0x6b,0x6b,0x3a,0x12,0x00,0x46,0x66,0x30,0x18,0x0c,0x66,0x62,0x00,
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  0x02,0x03,0x01,0x03,0x02,0x03,0x01,0x00,0x70,0x78,0x4c,0x46,0x4c,0x78,0x70,0x00};
const uint8_t ucBigFont[] = {
  0x00,0x00,0x00,0x00,0x00,0x00,0x00,0x00,0x00,0x00,0x00,0x00,0x00,0x00,0x00,0x00,
  0x00,0x00,0x00,0x00,0x00,0x00,0x00,0x00,0x00,0x00,0x00,0x00,0x00,0x00,0x00,0x00,
  0x00,0x00,0x00,0x00,0x00,0x00,0x00,0x00,0x00,0x00,0x00,0x00,0x00,0x00,0x00,0x00,
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  0x00,0x00,0x00,0x00,0x00,0x00,0x00,0x00,0x00,0x00,0x00,0x00,0x00,0x00,0x00,0x00};

  // 5x7 font (in 6x8 cell)
const uint8_t ucSmallFont[] = {
0x00,0x00,0x00,0x00,0x00,0x00,0x00,0x00,0x06,0x5f,0x06,0x00,0x00,0x07,0x03,0x00,
0x07,0x03,0x00,0x24,0x7e,0x24,0x7e,0x24,0x00,0x24,0x2b,0x6a,0x12,0x00,0x00,0x63,
0x13,0x08,0x64,0x63,0x00,0x36,0x49,0x56,0x20,0x50,0x00,0x00,0x07,0x03,0x00,0x00,
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  0x41,0x41,0x3e,0x08,0x00,0x02,0x01,0x02,0x01,0x00,0x00,0x3c,0x26,0x23,0x26,0x3c};

//
// Draw a string of small (8x8) or large (16x32) characters
// At the given col+row
//
int DrawString(int x, int y, char *szMsg, uint16_t u16FG, uint16_t u16BG, int iFontSize)
{
int i, j, k, iLen;
int l;
unsigned char *s;
uint16_t u16Tmp[512];

    iLen = (int)strlen(szMsg);
    if (iFontSize == FONT_16x32) // draw 16x32 font
    {
        if (iLen*16 + x > width) iLen = (width - x) / 16;
        if (iLen < 0) return -1;
        for (i=0; i<iLen; i++)
        {
            s = (uint8_t *)&ucBigFont[((unsigned char)szMsg[i]-32)*64];
            for (l=0; l<4; l++) // 4 sets of 8 rows
            {
                uint8_t ucMask = 1;
                for (k=0; k<8; k++) // for each scanline
                { // left half
                    uint16_t *d = &u16Tmp[((l*8+k)*16)];
                    for (j=0; j<16; j++)
                    {
                        if (s[j] & ucMask)
                            *d = u16FG;
                        else
                            *d = u16BG;
                        d++;
                    } // for j
                    ucMask <<= 1;
                } // for each scanline
                s += 16;
            } // for each set of 8 scanlines
            M5.Lcd.drawBitmap(x, y, 16, 32, u16Tmp);
            x += 16;
        } // for each character
    }
    if (iFontSize == FONT_8x8 || iFontSize == FONT_6x8) // draw the 6x8 or 8x8 font
    {
        uint16_t *u16D;
        int cx;
        uint8_t *pFont;

        cx = (iFontSize == FONT_8x8) ? 8:6;
        pFont = (iFontSize == FONT_8x8) ? (uint8_t *)ucFont : (uint8_t *)ucSmallFont;
        if ((cx*iLen) + x > width) iLen = (width - x)/cx; // can't display it all
        if (iLen < 0)return -1;

        for (i=0; i<iLen; i++)
        {
            s = &pFont[((unsigned char)szMsg[i]-32) * cx];
            uint8_t ucMask = 1;
            for (k=0; k<8; k++) // for each scanline
            {
                u16D = &u16Tmp[(k * cx)];
                for (j=0; j<cx; j++)
                {
                    if (s[j] & ucMask)
                        *u16D = u16FG;
                    else
                        *u16D = u16BG;
                    u16D++;
                } // for j
                ucMask <<= 1;
            } // for k
            M5.Lcd.drawBitmap(x, y, cx, 8, u16Tmp);
            x += cx;
        } // for i
    } // 6x8 and 8x8
    if (iFontSize == FONT_12x16) // 6x8 stretched to 12x16 (with smoothing)
    {
        uint16_t *u16D;
        
        if ((12*iLen) + x > width) iLen = (width - x)/12; // can't display it all
        if (iLen < 0)return -1;
        
        for (i=0; i<iLen; i++)
        {
            s = (uint8_t *)&ucSmallFont[((unsigned char)szMsg[i]-32) * 6];
            u16D = u16Tmp;
            uint8_t ucMask = 1;
            // start with all BG color
            for (k=0; k<16; k++)
            {
               for (j=0; j<12; j++)
                  u16D[(k*12) + j] = u16BG;
            }
            for (k=0; k<8; k++) // for each scanline
            {
                uint8_t c0, c1;
                for (j=0; j<6; j++)
                {
                    c0 = s[j];
                    if (c0 & ucMask)
                       u16D[0] = u16D[1] = u16D[12] = u16D[12+1] = u16FG;
                    // test for smoothing diagonals
                    if (k < 7 && j < 5) {
                       uint8_t ucMask2 = ucMask << 1;
                       c1 = s[j+1];
                       if ((c0 & ucMask) && (~c1 & ucMask) && (~c0 & ucMask2) && (c1 & ucMask2)) // first diagonal condition
                           u16D[12+2] = u16D[12*2+1] = u16FG;
                       else if ((~c0 & ucMask) && (c1 & ucMask) && (c0 & ucMask2) && (~c1 & ucMask2))
                           u16D[12+1] = u16D[12*2+2] = u16FG;
                    } // if not on last row and last col
                    u16D+=2;
                } // for j
                u16D += 12; // skip the extra line
                ucMask <<= 1;
            } // for k
            M5.Lcd.drawBitmap(x, y, 12, 16, u16Tmp);
            x += 12;
        } // for i
    } // FONT_12x16
    if (iFontSize == FONT_16x16) // 8x8 stretched to 16x16
    {
        uint16_t *u16D;
        
        if ((16*iLen) + x > width) iLen = (width - x)/16; // can't display it all
        if (iLen < 0)return -1;
        
        for (i=0; i<iLen; i++)
        {
            s = (uint8_t *)&ucFont[((unsigned char)szMsg[i]-32) * 8];
            u16D = u16Tmp;
            uint8_t ucMask = 1;
            for (k=0; k<8; k++) // for each scanline
            {
                uint8_t c0;
                for (j=0; j<8; j++)
                {
                    c0 = s[j];
                    if (c0 & ucMask)
                        u16D[0] = u16D[1] = u16D[16] = u16D[16+1] = u16FG;
                    else
                        u16D[0] = u16D[1] = u16D[16] = u16D[16+1] = u16BG;
                    u16D += 2;
                } // for j
                u16D += 16; // skip the next line
                ucMask <<= 1;
            } // for k
            M5.Lcd.drawBitmap(x, y, 16, 16, u16Tmp);
            x += 16;
        } // for i
    } // FONT_16x16
    return RD_SUCCESS;
} /* DrawString() */

void RDWrite(uint16_t *pu16, int iLen)
{
  switch (pu16[0] & 0xff) // remote display command
  {
     case RD_INIT:
            display_type = pu16[1];
            original_width = width = xres_list[display_type];
            original_height = height = yres_list[display_type];
            bpp = bpp_list[display_type];
            orientation = 0;
       break;
       
     case RD_FILL:
       M5.Lcd.fillScreen(pu16[1]);
       break;
       
      case RD_SET_WINDOW:
          window_x = pu16[1];
          window_y = pu16[2];
          window_w = pu16[3];
          window_h = pu16[4];
          cursor_x = window_x;
          cursor_y = window_y;
          M5.Lcd.setAddrWindow(window_x, window_y, window_w, window_h);
          break;

         case RD_SET_ORIENTATION:
         {
            orientation = pu16[1];
            int iRot = 0;
            if (orientation == 90 || orientation == 270)
            {
                width = original_height;
                height = original_width;
                iRot = (orientation == 90) ? 1:3;
            }
            else
            {
                width = original_width;
                height = original_height;
                iRot = (orientation == 0) ? 0:2;
            }
            M5.Lcd.setRotation(iRot);
        }
        break;

     case RD_WRITE_PIXELS:
        {
            int iCount = pu16[1] / 2; // turn bytes into pixels
            uint16_t *s = &pu16[3];
            M5.Lcd.startWrite();
            M5.Lcd.writePixels(s, iCount); // write the pixels
            M5.Lcd.endWrite();
        }
       break;

        case RD_DRAW_TEXT:
        {
            int x, y, iFontSize, len;
            char msg[512];
            uint16_t u16FG, u16BG;
            len = pu16[1];
            x = pu16[2];
            y = pu16[3];
            iFontSize = pu16[4];
            u16FG = pu16[5];
            u16BG = pu16[6];
            memcpy(msg, &pu16[7], len);
            msg[len] = 0; // zero terminate the string
            DrawString(x, y, msg, u16FG, u16BG, iFontSize);
        }
        break;

     case RD_DRAW_LINE:
       int x1,y1,x2,y2;
       uint16_t u16Color;
       x1 = pu16[1];
       y1 = pu16[2];
       x2 = pu16[3];
       y2 = pu16[4];
       u16Color = pu16[5];
       M5.Lcd.drawLine(x1, y1, x2, y2, u16Color);
       break;
       
     case RD_DRAW_ELLIPSE:
        {
            int iCenterX, iCenterY, iRadiusX, iRadiusY, bFilled;
            uint16_t u16Color;
            iCenterX = pu16[1];
            iCenterY = pu16[2];
            iRadiusX = pu16[3];
            iRadiusY = pu16[4];
            if (iRadiusX > 0 && iRadiusY > 0)
            {
                u16Color = pu16[5];
                bFilled = pu16[6];
                if (bFilled)
                  M5.Lcd.fillEllipse(iCenterX, iCenterY, iRadiusX, iRadiusY, u16Color);
                else
                  M5.Lcd.drawEllipse(iCenterX, iCenterY, iRadiusX, iRadiusY, u16Color);
            }
        }
        break;
  } // switch
} /* RDWrite() */

class CharacteristicCallbacks: public BLECharacteristicCallbacks {
     void onWrite(BLECharacteristic *characteristic) {
        static uint8_t buffer[256];
        static int iBufTotal, iBufLen = 0;
        int len;
        unsigned char *p, *pData = NULL, bSendIt = 0;
        
          std::string rxValue = characteristic->getValue(); 
          len = rxValue.length();
          if (len > 0) {
              p = (uint8_t *)rxValue.c_str();
          // normal packet, pass it along
          if (iBufLen == 0 && p[1] == 0) {
             pData = p;
             bSendIt = 1;
          } else if (iBufLen == 0 && p[1] != 0) { // start of a long packet
            if (len != (int)p[1]) // we received partial data (probably Adafruit BLE sending it)
            {
              iBufLen = p[1];
              memcpy(buffer, p, len); // copy what we're given
              iBufTotal += len;
            }
            else // we got everything, so no worries
            {
              bSendIt = 1;
              pData = p;
            }
          } else if (iBufLen != 0 && iBufTotal < iBufLen) { // we had partial data from a previous packet
            memcpy(&buffer[iBufTotal], p, len); // get new data
            iBufTotal += len;
            if (iBufTotal >= iBufLen) // we got everything
            {
              pData = buffer;
              len = iBufLen;
              iBufLen = iBufTotal = 0;
              bSendIt = 1; // send it
            }
         }
       if (bSendIt) {
          bSendIt = 0;
          RDWrite((uint16_t *)pData, len);
          }
        } // if (len > 0)
     }/* onWrite() */
     
     void onRead (BLECharacteristic *characteristic) {
        characteristic->setValue(u16Buttons);
     } /* onRead() */ 
};

void setup() {
  M5.begin();
  M5.Lcd.setRotation(1);
  orientation = 90; // default values
  width = 320;
  height = 240;
  bpp = 16;
  Serial.begin(115200);
  DrawString(48, 0, (char *)"Remote Display", 0xffe0, 0, FONT_16x16);
  DrawString(34, 40, (char *)"written by Larry Bank", 0x7e0, 0, FONT_12x16);

  BLEDevice::init("RemoteDisplay");
  BLEDevice::setMTU(256); // allow bigger MTU size
  pServer = BLEDevice::createServer();
  pService = pServer->createService(serviceUUID);
  
  pCharacteristic = pService->createCharacteristic(
                                         dataUUID1,
                                         BLECharacteristic::PROPERTY_READ |
                                         BLECharacteristic::PROPERTY_WRITE |
                                         BLECharacteristic::PROPERTY_WRITE_NR |
                                         BLECharacteristic::PROPERTY_INDICATE
                                       );

  pCharacteristic->setCallbacks(new CharacteristicCallbacks());
  pCharacteristic->setValue(u16Buttons);
  pService->start();
  pAdvertising = BLEDevice::getAdvertising();
  pAdvertising->addServiceUUID(serviceUUID);
//  pAdvertising->setScanResponse(true);
//  pAdvertising->setMinPreferred(0x06);  // functions that help with iPhone connections issue
//  pAdvertising->setMinPreferred(0x12);
  BLEDevice::startAdvertising();
}

void loop() {
  yield();
  M5.update(); // update touch controller info
  if (M5.Touch.changed) {
    // check the touch buttons we defined
    u16Buttons = (b0.isPressed());
    u16Buttons |= ((b1.isPressed()) << 1);
    u16Buttons |= ((b2.isPressed()) << 2);
//    Serial.println(u16Buttons, HEX);
  }
} /* loop() */
